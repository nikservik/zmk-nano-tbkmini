## config/boards/shields/cnano/Kconfig.defconfig
```kconfig
if SHIELD_CNANO_RIGHT

config ZMK_KEYBOARD_NAME
    default "cnano"

config ZMK_SPLIT_ROLE_CENTRAL
    default y

endif


if SHIELD_CNANO_LEFT || SHIELD_CNANO_RIGHT

config ZMK_SPLIT
    default y

endif

config MOUSE_LAYER_INDEX
    int "Index of mouse layer"
    default 6

config SCROLL_LAYER_INDEX
    int "Index of scroll layer"
    default 5

config MOUSE_LAYER_ACTIVE_MS
    int "Amount of milliseconds the mouse layer will be active after using the trackball"
    default 400
```

## config/boards/shields/cnano/Kconfig.shield
```kconfig
# Copyright (c) 2022 Casey Webster, Lau Kar Rui
# SPDX-License-Identifier: MIT

config SHIELD_CNANO_LEFT
    def_bool $(shields_list_contains,cnano_left)
 
config SHIELD_CNANO_RIGHT
    def_bool $(shields_list_contains,cnano_right)
```

## config/boards/shields/tbkmini/Kconfig.shield
```kconfig
# Copyright (c) 2022 Casey Webster, Lau Kar Rui
# SPDX-License-Identifier: MIT

config SHIELD_TBKMINI_LEFT
    def_bool $(shields_list_contains,tbkmini_left)
 
config SHIELD_TBKMINI_RIGHT
    def_bool $(shields_list_contains,tbkmini_right)
```
